## projects/cry-detect-01/main/Kconfig.projbuild
```kconfig
menu "Cry-detect-01"

    config CRY_DETECT_SAMPLE_RATE
        int "Audio sample rate (Hz)"
        default 16000
        help
            Must match YAMNet expectation (16 000 Hz). Do not change unless
            switching to a retrained model.

    config CRY_DETECT_MIC_GAIN_DB
        int "ES7210 analog PGA gain (dB)"
        default 36
        range 0 50
        help
            Start 36 dB indoors; raise for quiet rooms. Check /metrics RMS.

    config CRY_DETECT_THRESHOLD
        int "Class-20 INT8 detection threshold"
        default 40
        range -128 127
        help
            Raw INT8 logit threshold for class 20 (Baby cry, infant cry).
            40 ≈ 0.31 after dequantisation on a symmetric [-1, 1] output.
            Raise to reduce false positives, lower to increase sensitivity.

    config CRY_DETECT_CONSEC_FRAMES
        int "Consecutive frames over threshold to alert"
        default 6
        range 1 20
        help
            Temporal smoothing. With ~1.4 inferences/s, 6 frames ≈ 4.3 s of
            sustained above-threshold cry evidence before LED fires. Raised
            from 3 → 6 on 2026-04-18 after threshold dropped 0.85 → 0.65 to
            catch true cries (the synthetic-PTQ calibration keeps cry_conf
            above 0.55 even in silence, so we lean on temporal smoothing
            for stability rather than a tight threshold).

    config CRY_DETECT_HOLD_MS
        int "Alert hold duration (ms)"
        default 5000
        range 500 60000

    config CRY_DETECT_MODEL_PATH
        string "YAMNet .tflite path on SPIFFS"
        default "/yamnet/yamnet.tflite"

    config CRY_DETECT_TENSOR_ARENA_KB
        int "TFLite Micro tensor arena (KB, PSRAM)"
        default 1024
        range 256 4096

    menu "Distilled student (parallel — Phase A)"

        config CRY_STUDENT_ENABLED
            bool "Run distilled student in parallel with YAMNet"
            default n
            help
                Loads a second TFLite-Micro model (the v0.x.x INT8
                student published from chayuto/yamnet-cry-distill-int8)
                and runs it on the same mel patches as YAMNet. Adds
                parallel cry_conf/speech_conf/latency/version fields to
                /metrics, the JSONL logger, and the SSE inference event.
                Does NOT touch the detector trigger logic — teacher
                still drives detector_submit().

                Used for on-device validation before student replaces
                teacher. See yamnet-cry-distill-int8 docs/research/
                student-integration-plan-20260503.md.

        config CRY_STUDENT_MODEL_PATH
            string "Student .tflite path on SPIFFS"
            default "/yamnet/student.tflite"
            depends on CRY_STUDENT_ENABLED

        config CRY_STUDENT_TENSOR_ARENA_KB
            int "Student tensor arena (KB, PSRAM)"
            default 256
            range 32 1024
            depends on CRY_STUDENT_ENABLED
            help
                Static host estimate of student.tflite tensor sizes is
                ~170 KB before TFLite-Micro's lifetime-aware buffer reuse;
                the real on-device number is usually 50-70 % of that, but
                we default to 256 KB for headroom. Watch boot log for
                arena_used_bytes vs allocated and trim if PSRAM pressure
                becomes a constraint elsewhere.

        config CRY_STUDENT_VERSION
            string "Student model version tag"
            default "v0.2.0"
            depends on CRY_STUDENT_ENABLED
            help
                String tag baked into every metrics_logger row, /metrics
                response, and SSE inference event. Bump when flashing a
                new student .tflite. Convention: matches the HuggingFace
                v-tag of the published artifact (e.g. v0.2.0).

    endmenu

    config CRY_DETECT_WEB_UI_ENABLED
        bool "Enable HTTP web UI"
        default y

    config CRY_DETECT_SSE_MAX_CLIENTS
        int "Max concurrent SSE clients"
        default 2
        range 1 4
        depends on CRY_DETECT_WEB_UI_ENABLED

    config CRY_DETECT_SD_ENABLED
        bool "Mount SD card for logging"
        default y
        help
            Fails soft if card absent. Falls back to logs_fat partition.

    config CRY_DETECT_LOG_ROTATE_KB
        int "Rotate log file every N KB"
        default 256
        range 32 2048

    config CRY_DETECT_LED_EXPANDER_PIN
        int "CH32V003 IO-expander pin for red LED (active-LOW)"
        default 6
        range 0 7

    config CRY_DETECT_BUTTON_GPIO
        int "User button GPIO"
        default 15

    menu "Live audio stream"

        config CRY_STREAM_COMPILED_IN
            bool "Include live audio streaming endpoint"
            default y
            help
                Master compile-time toggle. Streaming defaults to OFF at
                boot regardless — browser must opt in.

        config CRY_STREAM_MAX_LISTENERS
            int "Max concurrent stream listeners"
            default 2
            range 1 4
            depends on CRY_STREAM_COMPILED_IN

        config CRY_STREAM_RING_KB
            int "Per-listener ring buffer size (KB)"
            default 32
            range 8 256
            depends on CRY_STREAM_COMPILED_IN

    endmenu

    menu "Event recorder (auto-WAV on detect)"

        config CRY_REC_COMPILED_IN
            bool "Record 40 s of PCM around each detection"
            default y

        config CRY_REC_PREROLL_S
            int "Pre-roll seconds (kept in PSRAM ring)"
            default 10
            range 1 30
            depends on CRY_REC_COMPILED_IN

        config CRY_REC_POSTROLL_S
            int "Post-trigger recording seconds"
            default 30
            range 5 120
            depends on CRY_REC_COMPILED_IN

        config CRY_REC_KEEP_FILES
            int "Max retained WAV files (oldest deleted)"
            default 500
            range 5 5000
            depends on CRY_REC_COMPILED_IN
            help
                Upper bound on WAVs kept in the events directory. At 40 s
                per clip (1.28 MB) a 32 GB card fits ~12k; default 500 leaves
                ample headroom for labeled training data collection.

    endmenu

    menu "RMS-threshold auto-trigger (data collection fallback)"

        config CRY_AUTO_TRIG_ENABLED
            bool "Auto-trigger recordings from RMS-vs-noise-floor crossings"
            default y
            help
                Fires event_recorder_trigger_manual("auto-rms-...") when input RMS
                sustains above (multiplier * noise_floor_p95) for sustain_ms.
                Model-independent fallback while the INT8 YAMNet head is saturated.
                Useful for overnight data collection — any loud event gets captured
                with labeled file so false-positives can be culled in the morning.

        config CRY_AUTO_TRIG_MULTIPLIER
            int "Threshold multiplier over noise_floor_p95"
            default 5
            range 2 20
            depends on CRY_AUTO_TRIG_ENABLED

        config CRY_AUTO_TRIG_ABS_RMS
            int "Absolute minimum RMS floor (safety against 0-p95 quiet-room)"
            default 200
            range 50 2000
            depends on CRY_AUTO_TRIG_ENABLED

        config CRY_AUTO_TRIG_SUSTAIN_MS
            int "Sustain time above threshold before firing (ms)"
            default 1500
            range 200 10000
            depends on CRY_AUTO_TRIG_ENABLED

        config CRY_AUTO_TRIG_COOLDOWN_S
            int "Cooldown between triggers (s)"
            default 60
            range 10 600
            depends on CRY_AUTO_TRIG_ENABLED

    endmenu

    menu "Adaptive noise floor"

        config CRY_NOISE_FLOOR_ENABLED
            bool "Learn ambient noise floor and scale threshold"
            default y

        config CRY_NOISE_FLOOR_WARMUP_S
            int "Warm-up window before adaptation begins (s)"
            default 300
            range 30 1800
            depends on CRY_NOISE_FLOOR_ENABLED

        config CRY_NOISE_FLOOR_MARGIN_X100
            int "Threshold margin above baseline (× 0.01)"
            default 10
            range 0 50
            depends on CRY_NOISE_FLOOR_ENABLED
            help
                Final threshold = base + (this/100) when noise floor is
                high. 10 = +0.10 when ambient is loud.

    endmenu

    menu "Sync subsystem (Phase B)"

        config CRY_SYNC_HOURLY_BUCKETS
            bool "Hourly-bucketed inference logs (infer-YYYYMMDDTHH.jsonl)"
            default n
            help
                Replaces day-bucketed JSONL with hourly. Closed hour-buckets
                are immutable and registered with the sync ledger. Only the
                current hour's file is mutable. No gzip yet; that lands as
                B.5 once core-0 CPU has been measured. Off keeps the
                day-bucketed behavior used pre-Phase-B.

        config CRY_SYNC_RANGE_GET
            bool "Support Range: bytes=N- on /files/get (HTTP 206)"
            default y
            help
                Single-range only. Cheap to support; no protocol cost when
                the client doesn't send Range. Defaults to y because it's
                safe and unblocks the new sync.py resume path.

        config CRY_SYNC_LEDGER_ENABLED
            bool "Enable .sync-ledger.jsonl (per-file sync state)"
            default n
            help
                Append-only JSONL on /sdcard/.sync-ledger.jsonl. Records
                file create + ack events. Required for /manifest.json to
                report sha256 + sync_state. Hourly compaction.

        config CRY_SYNC_LEDGER_MAX_FILES
            int "Max tracked files in sync ledger (in-memory hash)"
            default 4096
            range 256 16384
            depends on CRY_SYNC_LEDGER_ENABLED
            help
                In-memory hash of the latest state per path. Each entry
                is ~64 bytes; default 4096 = ~256 KB PSRAM. Overflow logs
                a warning and forces compaction.

        config CRY_SYNC_API_ENABLED
            bool "Expose /manifest.json + /sync/ack endpoints"
            default n
            depends on CRY_SYNC_LEDGER_ENABLED
            help
                Manifest is paginated (since=<unix_seconds>) and
                chunk-streamed. /sync/ack flips per-file sync_state from
                pending to synced. Old /files/* endpoints stay live.

        config CRY_SYNC_SESSION_MARKER
            bool "Write /sdcard/.session-started-<ISO>.json on first boot"
            default n
            help
                One marker per boot, idempotent (skipped if a marker for
                the current boot_count was already written). Lets the
                host's sync.py identify session boundaries without a
                server-side database.

    endmenu

    menu "Log retention"

        config CRY_LOG_RETENTION_ENABLED
            bool "Enable device-side log retention task"
            default y
            help
                Periodically scans the SD root for day-bucketed log files
                (infer-YYYYMMDD.jsonl, cry-YYYYMMDD.log) and unlinks any
                that are older than the retention window. WAV retention
                is handled separately by event_recorder.c and is not
                affected by this.

        config CRY_LOG_RETENTION_DAYS
            int "Days to keep day-bucketed logs"
            default 14
            range 1 365
            depends on CRY_LOG_RETENTION_ENABLED

        config CRY_LOG_RETENTION_PERIOD_S
            int "Seconds between retention scans"
            default 3600
            range 60 86400
            depends on CRY_LOG_RETENTION_ENABLED
            help
                Cheap scan; once an hour is plenty. First run is
                delayed 60 s after boot to let NTP + SD settle.

        config CRY_SD_LOW_SPACE_MB
            int "Free-bytes threshold that raises sd_low_space"
            default 256
            range 16 4096
            help
                When /sdcard free bytes drop below this, metrics expose
                sd_low_space=true and log a warning. Does not delete
                anything — purely a signal so dashboards / bash monitor
                can react.

    endmenu

endmenu
```

## projects/cry-detect-01/sdkconfig.defaults.template
```kconfig
# Committed template. Copy to sdkconfig.defaults, fill in real creds, flash.
# Same content as sdkconfig.defaults but with placeholder Wi-Fi credentials.

CONFIG_IDF_TARGET="esp32s3"
CONFIG_ESPTOOLPY_FLASHSIZE_16MB=y
CONFIG_ESPTOOLPY_FLASHFREQ_80M=y
CONFIG_ESPTOOLPY_FLASHMODE_QIO=y

CONFIG_SPIRAM=y
CONFIG_SPIRAM_MODE_OCT=y
CONFIG_SPIRAM_SPEED_80M=y
CONFIG_SPIRAM_BOOT_INIT=y
CONFIG_SPIRAM_USE_MALLOC=y
CONFIG_SPIRAM_TRY_ALLOCATE_WIFI_LWIP=y
CONFIG_SPIRAM_MALLOC_RESERVE_INTERNAL=32768
CONFIG_SPIRAM_MALLOC_ALWAYSINTERNAL=1024

CONFIG_PARTITION_TABLE_CUSTOM=y
CONFIG_PARTITION_TABLE_CUSTOM_FILENAME="partitions.csv"
CONFIG_PARTITION_TABLE_OFFSET=0x8000

CONFIG_ESP_DEFAULT_CPU_FREQ_MHZ_240=y
CONFIG_ESP_CONSOLE_USB_SERIAL_JTAG=y

CONFIG_FREERTOS_HZ=1000
CONFIG_FREERTOS_UNICORE=n

CONFIG_FREERTOS_CHECK_STACKOVERFLOW_CANARY=y
CONFIG_HEAP_POISONING_LIGHT=y
CONFIG_ESP_TASK_WDT_EN=y
CONFIG_ESP_TASK_WDT_INIT=y
CONFIG_ESP_TASK_WDT_TIMEOUT_S=30
CONFIG_ESP_TASK_WDT_CHECK_IDLE_TASK_CPU0=n
CONFIG_ESP_TASK_WDT_CHECK_IDLE_TASK_CPU1=n
CONFIG_COMPILER_STACK_CHECK_MODE_STRONG=y

# Stage 2.6a metrics_logger: enumerates tasks + stack HWM every 1 Hz.
CONFIG_FREERTOS_USE_TRACE_FACILITY=y

# Stage 2.7 file API + date-stamped logs: 8.3 FAT can't fit
# "infer-YYYYMMDD.jsonl" or "cry-YYYYMMDD.log" — need LFN.
CONFIG_FATFS_LFN_HEAP=y
CONFIG_FATFS_MAX_LFN=255

# Post-mortem (hygiene audit 2026-04-18, P2 #19-#21): every panic writes
# a coredump ELF to flash — fetch via /files/get + addr2line offline, no
# more live serial-capture races. Caught by the mutex-owner assert.
CONFIG_ESP_COREDUMP_ENABLE_TO_FLASH=y
CONFIG_ESP_COREDUMP_DATA_FORMAT_ELF=y
CONFIG_ESP_COREDUMP_CHECKSUM_CRC32=y
CONFIG_ESP_COREDUMP_MAX_TASKS_NUM=16
CONFIG_ESP_PANIC_PRINT_MEMADDR=y
CONFIG_ESP_DEBUG_STUBS_ENABLE=y
CONFIG_FREERTOS_CHECK_MUTEX_GIVEN_BY_OWNER=y
# esp_event loop task: default 2304-byte stack was running tight (JSONL
# HWM showed sys_evt=608 free). Bumping to 4096 (audit P1 #22).
CONFIG_ESP_SYSTEM_EVENT_TASK_STACK_SIZE=4096

CONFIG_LWIP_SO_RCVBUF=y
CONFIG_ESP_WIFI_ENABLE_SAE_PK=y
CONFIG_ESP_WIFI_SOFTAP_SUPPORT=n

CONFIG_HTTPD_MAX_REQ_HDR_LEN=1024
CONFIG_HTTPD_MAX_URI_LEN=512
CONFIG_HTTPD_PURGE_BUF_LEN=1024

CONFIG_LOG_DEFAULT_LEVEL_INFO=y
CONFIG_LOG_COLORS=y

CONFIG_LWIP_SNTP_MAX_SERVERS=2

CONFIG_EXAMPLE_CONNECT_WIFI=y
CONFIG_EXAMPLE_WIFI_SSID="<YOUR_SSID>"
CONFIG_EXAMPLE_WIFI_PASSWORD="<YOUR_PASSWORD>"
CONFIG_EXAMPLE_WIFI_SCAN_METHOD_ALL_CHANNEL=y
CONFIG_EXAMPLE_WIFI_CONNECT_AP_BY_SIGNAL=y
CONFIG_EXAMPLE_WIFI_AUTH_WPA2_PSK=y

CONFIG_BSP_I2S_NUM=1
CONFIG_BSP_I2C_NUM=0
CONFIG_BSP_I2C_CLK_SPEED_HZ=400000
CONFIG_BSP_SD_MOUNT_POINT="/sdcard"

CONFIG_TFLITE_MICRO_USE_ESP_NN=y
```
